
/*
 * Licensed to the Apache Software Foundation (ASF) under one
 * or more contributor license agreements.  See the NOTICE file
 * distributed with this work for additional information
 * regarding copyright ownership.  The ASF licenses this file
 * to you under the Apache License, Version 2.0 (the
 * "License"); you may not use this file except in compliance
 * with the License.  You may obtain a copy of the License at
 *
 *   http://www.apache.org/licenses/LICENSE-2.0
 *
 * Unless required by applicable law or agreed to in writing,
 * software distributed under the License is distributed on an
 * "AS IS" BASIS, WITHOUT WARRANTIES OR CONDITIONS OF ANY
 * KIND, either express or implied.  See the License for the
 * specific language governing permissions and limitations
 * under the License.
 */

&rcc {
	clock-frequency = <DT_FREQ_M(120)>;
};

/*
   Set PLL accordingly to freq. reported by 'clock-frequency' property, where:

   VCO freq = PLL clock input freq (HSI: 16 MHz) * N / M and
   Core freq = VCO freq / R.

   Hence:

   VCO freq = 16 * 30 / 2 = 240 MHz and
   Core freq = 240 MHz / 2 = 120 MHz

   Prop. 'div-p' and 'div-q' will be inherited from the overlaid 'pll' node.
*/

&pll {
	div-m = <2>;
	mul-n = <30>;
	div-r = <2>;
	clocks = <&clk_hsi>;
	status = "okay";
};
