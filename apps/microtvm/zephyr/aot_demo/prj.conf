## CMakeLists.txt
```
# SPDX-License-Identifier: Apache-2.0

cmake_minimum_required(VERSION 3.13.1)

set(ENV{QEMU_BIN_PATH} "${CMAKE_SOURCE_DIR}/qemu-hack")

set(QEMU_PIPE "\${QEMU_PIPE}")  # QEMU_PIPE is set by the calling TVM instance.

find_package(Zephyr HINTS $ENV{ZEPHYR_BASE})
project(microtvm_zephyr_runtime)

set(CMAKE_VERBOSE_MAKEFILE ON)

target_sources(app PRIVATE src/zephyr_uart.c)
target_sources(app PRIVATE src/main.c)

foreach(tvm_lib ${TVM_LIBS})
  string(LENGTH ${tvm_lib} tvm_lib_length)
  math(EXPR tvm_lib_cut "${tvm_lib_length} - 2")
  string(SUBSTRING ${tvm_lib} 3 ${tvm_lib_cut} tvm_lib_name)
  add_library(${tvm_lib_name} STATIC IMPORTED)
  set_target_properties(${tvm_lib_name} PROPERTIES
      IMPORTED_LOCATION ${CMAKE_SOURCE_DIR}/${tvm_lib})
  target_link_libraries(app PRIVATE ${tvm_lib_name})
endforeach(tvm_lib ${TVM_LIBS})

target_include_directories(app PRIVATE ${TVM_INCLUDE_DIRS})
```

## prj.conf
```kconfig
# Licensed to the Apache Software Foundation (ASF) under one
# or more contributor license agreements.  See the NOTICE file
# distributed with this work for additional information
# regarding copyright ownership.  The ASF licenses this file
# to you under the Apache License, Version 2.0 (the
# "License"); you may not use this file except in compliance
# with the License.  You may obtain a copy of the License at
#
#   http://www.apache.org/licenses/LICENSE-2.0
#
# Unless required by applicable law or agreed to in writing,
# software distributed under the License is distributed on an
# "AS IS" BASIS, WITHOUT WARRANTIES OR CONDITIONS OF ANY
# KIND, either express or implied.  See the License for the
# specific language governing permissions and limitations
# under the License.

# The settings in this file are generic for all boards, and are merged
# with the settings in the file boards/<BOARD>.conf by the Zephyr build
# process.

# For UART implementation in main().
CONFIG_RING_BUFFER=y
CONFIG_UART_CONSOLE=n
CONFIG_UART_INTERRUPT_DRIVEN=y

# For RPC server C++ bindings.
CONFIG_CPLUSPLUS=y
CONFIG_NEWLIB_LIBC=y

# For models with floating point.
CONFIG_FPU=y

# For TVMPlatformAbort().
CONFIG_REBOOT=y
```

## boards/nrf5340dk_nrf5340_cpuapp.conf
```kconfig
# Licensed to the Apache Software Foundation (ASF) under one
# or more contributor license agreements.  See the NOTICE file
# distributed with this work for additional information
# regarding copyright ownership.  The ASF licenses this file
# to you under the Apache License, Version 2.0 (the
# "License"); you may not use this file except in compliance
# with the License.  You may obtain a copy of the License at
#
#   http://www.apache.org/licenses/LICENSE-2.0
#
# Unless required by applicable law or agreed to in writing,
# software distributed under the License is distributed on an
# "AS IS" BASIS, WITHOUT WARRANTIES OR CONDITIONS OF ANY
# KIND, either express or implied.  See the License for the
# specific language governing permissions and limitations
# under the License.
#
# This file is specific to the nRF5340 DK board.

# For intrinsics used by generated optimized operators.
CONFIG_CMSIS_DSP=y

# For AOT runtime which requires lots of function call.
CONFIG_MAIN_STACK_SIZE=2000

# For random number generation.
CONFIG_ENTROPY_GENERATOR=y
CONFIG_TEST_RANDOM_GENERATOR=y

# For debugging.
CONFIG_LED=y

# For models with floating point.
CONFIG_FPU=y
```

## boards/nucleo_f746zg.conf
```kconfig
# Licensed to the Apache Software Foundation (ASF) under one
# or more contributor license agreements.  See the NOTICE file
# distributed with this work for additional information
# regarding copyright ownership.  The ASF licenses this file
# to you under the Apache License, Version 2.0 (the
# "License"); you may not use this file except in compliance
# with the License.  You may obtain a copy of the License at
#
#   http://www.apache.org/licenses/LICENSE-2.0
#
# Unless required by applicable law or agreed to in writing,
# software distributed under the License is distributed on an
# "AS IS" BASIS, WITHOUT WARRANTIES OR CONDITIONS OF ANY
# KIND, either express or implied.  See the License for the
# specific language governing permissions and limitations
# under the License.
#
# This file is specific to the STM32F746 Nucleo board.

# For intrinsics used by generated optimized operators.
CONFIG_CMSIS_DSP=y

# For operations that stack allocates a large float array.
CONFIG_MAIN_STACK_SIZE=1536

# For random number generation.
CONFIG_ENTROPY_GENERATOR=y

# For debugging.
CONFIG_LED=y
```

## boards/nucleo_l4r5zi.conf
```kconfig
# Licensed to the Apache Software Foundation (ASF) under one
# or more contributor license agreements.  See the NOTICE file
# distributed with this work for additional information
# regarding copyright ownership.  The ASF licenses this file
# to you under the Apache License, Version 2.0 (the
# "License"); you may not use this file except in compliance
# with the License.  You may obtain a copy of the License at
#
#   http://www.apache.org/licenses/LICENSE-2.0
#
# Unless required by applicable law or agreed to in writing,
# software distributed under the License is distributed on an
# "AS IS" BASIS, WITHOUT WARRANTIES OR CONDITIONS OF ANY
# KIND, either express or implied.  See the License for the
# specific language governing permissions and limitations
# under the License.
#
# This file is specific to the STM32L4R5ZI Nucleo board.

# For intrinsics used by generated optimized operators.
CONFIG_CMSIS_DSP=y

# For AOT runtime which requires lots of function call.
CONFIG_MAIN_STACK_SIZE=3000

# For random number generation.
CONFIG_ENTROPY_GENERATOR=y
CONFIG_TEST_RANDOM_GENERATOR=y

# For debugging.
CONFIG_LED=y
```

## boards/qemu_cortex_r5.conf
```kconfig
# Licensed to the Apache Software Foundation (ASF) under one
# or more contributor license agreements.  See the NOTICE file
# distributed with this work for additional information
# regarding copyright ownership.  The ASF licenses this file
# to you under the Apache License, Version 2.0 (the
# "License"); you may not use this file except in compliance
# with the License.  You may obtain a copy of the License at
#
#   http://www.apache.org/licenses/LICENSE-2.0
#
# Unless required by applicable law or agreed to in writing,
# software distributed under the License is distributed on an
# "AS IS" BASIS, WITHOUT WARRANTIES OR CONDITIONS OF ANY
# KIND, either express or implied.  See the License for the
# specific language governing permissions and limitations
# under the License.

# This file is specific to the QEMU-emulated Cortex R5 microTVM board.

# For TVMPlatformGenerateRandom(). Remember, these values do not need to be truly random.
CONFIG_TEST_RANDOM_GENERATOR=y
CONFIG_TIMER_RANDOM_GENERATOR=y

# Default stack size is 1k, this is required for debug mode. 
CONFIG_MAIN_STACK_SIZE=2000
```

## boards/qemu_x86.conf
```kconfig
# Licensed to the Apache Software Foundation (ASF) under one
# or more contributor license agreements.  See the NOTICE file
# distributed with this work for additional information
# regarding copyright ownership.  The ASF licenses this file
# to you under the Apache License, Version 2.0 (the
# "License"); you may not use this file except in compliance
# with the License.  You may obtain a copy of the License at
#
#   http://www.apache.org/licenses/LICENSE-2.0
#
# Unless required by applicable law or agreed to in writing,
# software distributed under the License is distributed on an
# "AS IS" BASIS, WITHOUT WARRANTIES OR CONDITIONS OF ANY
# KIND, either express or implied.  See the License for the
# specific language governing permissions and limitations
# under the License.

# This file is specific to the QEMU-emulated microTVM board.

# For TVMPlatformGenerateRandom(). Remember, these values do not need to be truly random.
CONFIG_TEST_RANDOM_GENERATOR=y
CONFIG_TIMER_RANDOM_GENERATOR=y

# Default stack size is 1k, this is required for debug mode. 
CONFIG_MAIN_STACK_SIZE=2000

# For models with floating point.
CONFIG_FPU=y
```

## src/main.c
```c
/*
 * Licensed to the Apache Software Foundation (ASF) under one
 * or more contributor license agreements.  See the NOTICE file
 * distributed with this work for additional information
 * regarding copyright ownership.  The ASF licenses this file
 * to you under the Apache License, Version 2.0 (the
 * "License"); you may not use this file except in compliance
 * with the License.  You may obtain a copy of the License at
 *
 *   http://www.apache.org/licenses/LICENSE-2.0
 *
 * Unless required by applicable law or agreed to in writing,
 * software distributed under the License is distributed on an
 * "AS IS" BASIS, WITHOUT WARRANTIES OR CONDITIONS OF ANY
 * KIND, either express or implied.  See the License for the
 * specific language governing permissions and limitations
 * under the License.
 */

#include <assert.h>
#include <float.h>
#include <kernel.h>
#include <power/reboot.h>
#include <stdio.h>
#include <string.h>
#include <tvm/runtime/c_runtime_api.h>
#include <tvm/runtime/crt/internal/aot_executor/aot_executor.h>
#include <tvm/runtime/crt/logging.h>
#include <tvm/runtime/crt/stack_allocator.h>
#include <unistd.h>
#include <zephyr.h>

#include "input_data.h"
#include "output_data.h"
#include "tvmgen_default.h"
#include "zephyr_uart.h"

#ifdef CONFIG_ARCH_POSIX
#include "posix_board_if.h"
#endif

#define WORKSPACE_SIZE (270 * 1024)

static uint8_t g_aot_memory[WORKSPACE_SIZE];
extern tvm_model_t tvmgen_default_network;
tvm_workspace_t app_workspace;

// Wakeup sequence used to wake up QEMU on the host.
const unsigned char g_wakeup_sequence[12] = {0xfe, 0xff, 0xfd, 0x03, 0x00, 0x00,
                                             0x00, 0x00, 0x00, 0x02, 0x66, 0x77};
const char g_start_cmd[] = "start\n";

size_t TVMPlatformFormatMessage(char* out_buf, size_t out_buf_size_bytes, const char* fmt,
                                va_list args) {
  return vsnprintk(out_buf, out_buf_size_bytes, fmt, args);
}

void TVMLogf(const char* msg, ...) {
  char buffer[256];
  int size;
  va_list args;
  va_start(args, msg);
  size = vsprintf(buffer, msg, args);
  va_end(args);
  TVMPlatformWriteSerial(buffer, (uint32_t)size);
}

void TVMPlatformAbort(tvm_crt_error_t error) {
  TVMLogf("TVMPlatformAbort: %08x\n", error);
  sys_reboot(SYS_REBOOT_COLD);
  for (;;)
    ;
}

tvm_crt_error_t TVMPlatformMemoryAllocate(size_t num_bytes, DLDevice dev, void** out_ptr) {
  return StackMemoryManager_Allocate(&app_workspace, num_bytes, out_ptr);
}

tvm_crt_error_t TVMPlatformMemoryFree(void* ptr, DLDevice dev) {
  return StackMemoryManager_Free(&app_workspace, ptr);
}

void timer_expiry_function(struct k_timer* timer_id) { return; }

#define MILLIS_TIL_EXPIRY 200
#define TIME_TIL_EXPIRY (K_MSEC(MILLIS_TIL_EXPIRY))
struct k_timer g_microtvm_timer;
uint32_t g_microtvm_start_time;
int g_microtvm_timer_running = 0;

// Called to start system timer.
tvm_crt_error_t TVMPlatformTimerStart() {
  if (g_microtvm_timer_running) {
    TVMLogf("timer already running");
    return kTvmErrorPlatformTimerBadState;
  }

  k_timer_start(&g_microtvm_timer, TIME_TIL_EXPIRY, TIME_TIL_EXPIRY);
  g_microtvm_start_time = k_cycle_get_32();
  g_microtvm_timer_running = 1;
  return kTvmErrorNoError;
}

// Called to stop system timer.
tvm_crt_error_t TVMPlatformTimerStop(double* elapsed_time_seconds) {
  if (!g_microtvm_timer_running) {
    TVMLogf("timer not running");
    return kTvmErrorSystemErrorMask | 2;
  }

  uint32_t stop_time = k_cycle_get_32();

  // compute how long the work took
  uint32_t cycles_spent = stop_time - g_microtvm_start_time;
  if (stop_time < g_microtvm_start_time) {
    // we rolled over *at least* once, so correct the rollover it was *only*
    // once, because we might still use this result
    cycles_spent = ~((uint32_t)0) - (g_microtvm_start_time - stop_time);
  }

  uint32_t ns_spent = (uint32_t)k_cyc_to_ns_floor64(cycles_spent);
  double hw_clock_res_us = ns_spent / 1000.0;

  // need to grab time remaining *before* stopping. when stopped, this function
  // always returns 0.
  int32_t time_remaining_ms = k_timer_remaining_get(&g_microtvm_timer);
  k_timer_stop(&g_microtvm_timer);
  // check *after* stopping to prevent extra expiries on the happy path
  if (time_remaining_ms < 0) {
    return kTvmErrorSystemErrorMask | 3;
  }
  uint32_t num_expiries = k_timer_status_get(&g_microtvm_timer);
  uint32_t timer_res_ms = ((num_expiries * MILLIS_TIL_EXPIRY) + time_remaining_ms);
  double approx_num_cycles =
      (double)k_ticks_to_cyc_floor32(1) * (double)k_ms_to_ticks_ceil32(timer_res_ms);
  // if we approach the limits of the HW clock datatype (uint32_t), use the
  // coarse-grained timer result instead
  if (approx_num_cycles > (0.5 * (~((uint32_t)0)))) {
    *elapsed_time_seconds = timer_res_ms / 1000.0;
  } else {
    *elapsed_time_seconds = hw_clock_res_us / 1e6;
  }

  g_microtvm_timer_running = 0;
  return kTvmErrorNoError;
}

void* TVMBackendAllocWorkspace(int device_type, int device_id, uint64_t nbytes, int dtype_code_hint,
                               int dtype_bits_hint) {
  tvm_crt_error_t err = kTvmErrorNoError;
  void* ptr = 0;
  DLDevice dev = {device_type, device_id};
  assert(nbytes > 0);
  err = TVMPlatformMemoryAllocate(nbytes, dev, &ptr);
  CHECK_EQ(err, kTvmErrorNoError,
           "TVMBackendAllocWorkspace(%d, %d, %" PRIu64 ", %d, %d) -> %" PRId32, device_type,
           device_id, nbytes, dtype_code_hint, dtype_bits_hint, err);
  return ptr;
}

int TVMBackendFreeWorkspace(int device_type, int device_id, void* ptr) {
  tvm_crt_error_t err = kTvmErrorNoError;
  DLDevice dev = {device_type, device_id};
  err = TVMPlatformMemoryFree(ptr, dev);
  return err;
}

static uint8_t main_rx_buf[128];
static uint8_t cmd_buf[128];
static size_t g_cmd_buf_ind;

void main(void) {
  g_cmd_buf_ind = 0;
  memset((char*)cmd_buf, 0, sizeof(cmd_buf));
  TVMPlatformUARTInit();
  k_timer_init(&g_microtvm_timer, NULL, NULL);
  // Wake up host side.
  TVMPlatformWriteSerial(g_wakeup_sequence, sizeof(g_wakeup_sequence));

  // Wait for start command
  while (true) {
    int bytes_read = TVMPlatformUartRxRead(main_rx_buf, sizeof(main_rx_buf));
    if (bytes_read > 0) {
      memcpy((char*)cmd_buf + g_cmd_buf_ind, main_rx_buf, bytes_read);
      g_cmd_buf_ind += bytes_read;
    }
    if (g_cmd_buf_ind >= 6) {
      if (!strcmp((char*)(cmd_buf), g_start_cmd)) {
        break;
      } else {
        memset((char*)cmd_buf, 0, sizeof(cmd_buf));
        g_cmd_buf_ind = 0;
      }
    }
  }
  TVMLogf("Zephyr AOT Runtime\n");

  struct tvmgen_default_inputs inputs = {
      .input_1 = input_data,
  };
  struct tvmgen_default_outputs outputs = {
      .output = output_data,
  };

  StackMemoryManager_Init(&app_workspace, g_aot_memory, WORKSPACE_SIZE);

  double elapsed_time = 0;
  TVMPlatformTimerStart();
  int ret_val = tvmgen_default_run(&inputs, &outputs);
  TVMPlatformTimerStop(&elapsed_time);

  if (ret_val != 0) {
    TVMLogf("Error: %d\n", ret_val);
    TVMPlatformAbort(kTvmErrorPlatformCheckFailure);
  }

  size_t max_ind = -1;
  float max_val = -FLT_MAX;
  for (size_t i = 0; i < output_data_len; i++) {
    if (output_data[i] >= max_val) {
      max_ind = i;
      max_val = output_data[i];
    }
  }
  TVMLogf("#result:%d:%d\n", max_ind, (uint32_t)(elapsed_time * 1000));
#ifdef CONFIG_ARCH_POSIX
  posix_exit(0);
#endif
}
```

## include/input_data.h
```c
#include <stddef.h>
#include <stdint.h>
#include <dlpack/dlpack.h>
const size_t input_data_len = 3072;
float input_data[] = {147.0, 157.0, 175.0, 146.0, 157.0, 175.0, 149.0, 161.0, 179.0, 153.0, 165.0, 182.0, 155.0, 167.0, 183.0, 155.0, 169.0, 186.0, 156.0, 171.0, 189.0, 159.0, 173.0, 190.0, 163.0, 177.0, 193.0, 167.0, 180.0, 194.0, 172.0, 183.0, 195.0, 176.0, 186.0, 197.0, 178.0, 186.0, 198.0, 179.0, 187.0, 200.0, 179.0, 190.0, 201.0, 179.0, 190.0, 202.0, 178.0, 191.0, 204.0, 178.0, 192.0, 205.0, 178.0, 192.0, 205.0, 179.0, 192.0, 205.0, 175.0, 191.0, 203.0, 172.0, 191.0, 202.0, 175.0, 190.0, 203.0, 176.0, 190.0, 203.0, 177.0, 189.0, 203.0, 179.0, 189.0, 202.0, 179.0, 189.0, 198.0, 179.0, 188.0, 197.0, 177.0, 186.0, 196.0, 175.0, 183.0, 196.0, 172.0, 180.0, 193.0, 169.0, 177.0, 190.0, 151.0, 158.0, 176.0, 149.0, 158.0, 176.0, 151.0, 162.0, 179.0, 156.0, 166.0, 182.0, 159.0, 168.0, 185.0, 160.0, 171.0, 187.0, 162.0, 174.0, 190.0, 168.0, 177.0, 191.0, 174.0, 180.0, 192.0, 177.0, 183.0, 194.0, 179.0, 185.0, 195.0, 177.0, 188.0, 196.0, 178.0, 187.0, 196.0, 180.0, 189.0, 198.0, 182.0, 191.0, 200.0, 183.0, 191.0, 200.0, 183.0, 192.0, 202.0, 183.0, 193.0, 203.0, 183.0, 192.0, 203.0, 183.0, 192.0, 203.0, 181.0, 192.0, 202.0, 180.0, 192.0, 202.0, 180.0, 191.0, 201.0, 180.0, 190.0, 201.0, 180.0, 190.0, 201.0, 179.0, 189.0, 198.0, 178.0, 188.0, 195.0, 178.0, 187.0, 195.0, 176.0, 185.0, 195.0, 174.0, 182.0, 195.0, 171.0, 179.0, 192.0, 169.0, 177.0, 190.0, 159.0, 163.0, 176.0, 158.0, 163.0, 177.0, 159.0, 166.0, 180.0, 161.0, 169.0, 182.0, 164.0, 172.0, 185.0, 167.0, 174.0, 187.0, 170.0, 177.0, 190.0, 174.0, 180.0, 192.0, 179.0, 181.0, 193.0, 180.0, 184.0, 195.0, 181.0, 187.0, 196.0, 181.0, 189.0, 197.0, 182.0, 191.0, 199.0, 182.0, 191.0, 200.0, 182.0, 191.0, 200.0, 184.0, 192.0, 202.0, 185.0, 194.0, 203.0, 185.0, 195.0, 204.0, 184.0, 194.0, 203.0, 183.0, 193.0, 202.0, 182.0, 194.0, 202.0, 182.0, 194.0, 203.0, 182.0, 192.0, 201.0, 181.0, 191.0, 200.0, 181.0, 191.0, 200.0, 181.0, 190.0, 199.0, 180.0, 189.0, 197.0, 179.0, 188.0, 196.0, 178.0, 186.0, 194.0, 177.0, 184.0, 194.0, 174.0, 181.0, 192.0, 171.0, 180.0, 189.0, 166.0, 167.0, 176.0, 165.0, 167.0, 177.0, 166.0, 169.0, 180.0, 167.0, 171.0, 182.0, 169.0, 175.0, 185.0, 173.0, 176.0, 187.0, 176.0, 178.0, 190.0, 179.0, 181.0, 193.0, 181.0, 183.0, 195.0, 181.0, 185.0, 196.0, 181.0, 187.0, 195.0, 182.0, 189.0, 197.0, 182.0, 191.0, 200.0, 182.0, 191.0, 200.0, 184.0, 194.0, 202.0, 185.0, 195.0, 204.0, 184.0, 194.0, 203.0, 184.0, 194.0, 203.0, 183.0, 193.0, 202.0, 183.0, 193.0, 202.0, 182.0, 194.0, 202.0, 181.0, 194.0, 202.0, 181.0, 192.0, 201.0, 181.0, 191.0, 200.0, 181.0, 191.0, 200.0, 181.0, 190.0, 200.0, 180.0, 189.0, 198.0, 179.0, 188.0, 195.0, 178.0, 186.0, 194.0, 177.0, 184.0, 194.0, 174.0, 181.0, 191.0, 171.0, 180.0, 189.0, 168.0, 166.0, 173.0, 167.0, 166.0, 176.0, 169.0, 169.0, 179.0, 170.0, 171.0, 180.0, 172.0, 175.0, 183.0, 174.0, 176.0, 185.0, 177.0, 178.0, 187.0, 179.0, 180.0, 190.0, 179.0, 181.0, 193.0, 180.0, 184.0, 194.0, 180.0, 187.0, 195.0, 182.0, 189.0, 197.0, 182.0, 191.0, 200.0, 180.0, 190.0, 198.0, 169.0, 178.0, 188.0, 170.0, 180.0, 191.0, 183.0, 193.0, 202.0, 184.0, 192.0, 201.0, 184.0, 193.0, 202.0, 184.0, 193.0, 202.0, 182.0, 194.0, 202.0, 181.0, 194.0, 202.0, 181.0, 193.0, 201.0, 182.0, 191.0, 201.0, 182.0, 191.0, 200.0, 181.0, 190.0, 199.0, 180.0, 189.0, 197.0, 179.0, 188.0, 195.0, 178.0, 186.0, 194.0, 177.0, 184.0, 194.0, 173.0, 181.0, 191.0, 168.0, 178.0, 187.0, 166.0, 163.0, 172.0, 166.0, 165.0, 174.0, 168.0, 168.0, 178.0, 171.0, 171.0, 180.0, 173.0, 173.0, 181.0, 174.0, 175.0, 184.0, 175.0, 177.0, 186.0, 176.0, 179.0, 188.0, 178.0, 181.0, 190.0, 179.0, 183.0, 192.0, 180.0, 187.0, 195.0, 181.0, 188.0, 196.0, 182.0, 191.0, 198.0, 179.0, 188.0, 197.0, 91.0, 111.0, 134.0, 79.0, 109.0, 138.0, 169.0, 184.0, 198.0, 187.0, 194.0, 204.0, 184.0, 193.0, 203.0, 185.0, 194.0, 203.0, 184.0, 194.0, 203.0, 183.0, 195.0, 203.0, 183.0, 193.0, 202.0, 184.0, 192.0, 202.0, 183.0, 192.0, 200.0, 181.0, 190.0, 197.0, 180.0, 189.0, 196.0, 179.0, 188.0, 195.0, 177.0, 186.0, 194.0, 176.0, 183.0, 193.0, 173.0, 180.0, 190.0, 168.0, 179.0, 188.0, 165.0, 162.0, 171.0, 164.0, 164.0, 171.0, 167.0, 168.0, 174.0, 170.0, 171.0, 178.0, 172.0, 172.0, 180.0, 173.0, 174.0, 183.0, 173.0, 176.0, 185.0, 175.0, 178.0, 187.0, 177.0, 180.0, 189.0, 178.0, 182.0, 191.0, 179.0, 186.0, 194.0, 180.0, 187.0, 195.0, 183.0, 187.0, 196.0, 185.0, 190.0, 198.0, 104.0, 114.0, 131.0, 105.0, 130.0, 155.0, 180.0, 195.0, 207.0, 185.0, 192.0, 201.0, 185.0, 194.0, 204.0, 185.0, 194.0, 204.0, 186.0, 194.0, 203.0, 186.0, 193.0, 203.0, 185.0, 193.0, 201.0, 183.0, 193.0, 199.0, 183.0, 192.0, 199.0, 181.0, 190.0, 197.0, 180.0, 189.0, 196.0, 179.0, 188.0, 195.0, 177.0, 186.0, 194.0, 176.0, 183.0, 193.0, 173.0, 180.0, 190.0, 172.0, 179.0, 189.0, 165.0, 160.0, 169.0, 164.0, 163.0, 169.0, 167.0, 167.0, 172.0, 169.0, 169.0, 176.0, 170.0, 170.0, 178.0, 171.0, 173.0, 181.0, 172.0, 175.0, 184.0, 174.0, 177.0, 186.0, 176.0, 179.0, 188.0, 177.0, 181.0, 191.0, 179.0, 184.0, 194.0, 180.0, 186.0, 194.0, 181.0, 188.0, 196.0, 180.0, 182.0, 190.0, 151.0, 143.0, 146.0, 191.0, 188.0, 188.0, 215.0, 217.0, 219.0, 184.0, 188.0, 194.0, 183.0, 190.0, 196.0, 184.0, 192.0, 199.0, 185.0, 192.0, 200.0, 186.0, 192.0, 202.0, 188.0, 195.0, 201.0, 189.0, 197.0, 200.0, 182.0, 192.0, 197.0, 181.0, 190.0, 197.0, 179.0, 188.0, 196.0, 178.0, 187.0, 195.0, 177.0, 186.0, 194.0, 175.0, 183.0, 192.0, 172.0, 179.0, 189.0, 170.0, 176.0, 186.0, 165.0, 158.0, 167.0, 164.0, 161.0, 169.0, 166.0, 165.0, 173.0, 166.0, 166.0, 174.0, 168.0, 168.0, 176.0, 169.0, 171.0, 179.0, 170.0, 174.0, 183.0, 173.0, 176.0, 185.0, 175.0, 178.0, 187.0, 177.0, 180.0, 190.0, 179.0, 181.0, 194.0, 181.0, 183.0, 192.0, 181.0, 185.0, 193.0, 177.0, 183.0, 191.0, 158.0, 159.0, 166.0, 181.0, 182.0, 183.0, 215.0, 219.0, 222.0, 184.0, 192.0, 200.0, 184.0, 192.0, 197.0, 183.0, 190.0, 195.0, 178.0, 186.0, 193.0, 179.0, 188.0, 195.0, 186.0, 193.0, 198.0, 194.0, 199.0, 204.0, 180.0, 190.0, 197.0, 179.0, 188.0, 195.0, 177.0, 186.0, 194.0, 175.0, 184.0, 193.0, 174.0, 183.0, 192.0, 171.0, 180.0, 189.0, 168.0, 177.0, 186.0, 166.0, 175.0, 184.0, 164.0, 157.0, 165.0, 162.0, 159.0, 167.0, 164.0, 163.0, 171.0, 165.0, 165.0, 173.0, 167.0, 167.0, 175.0, 168.0, 170.0, 178.0, 169.0, 172.0, 181.0, 172.0, 175.0, 184.0, 174.0, 177.0, 186.0, 176.0, 179.0, 189.0, 178.0, 180.0, 190.0, 179.0, 182.0, 188.0, 180.0, 182.0, 191.0, 181.0, 187.0, 194.0, 174.0, 176.0, 179.0, 187.0, 188.0, 192.0, 220.0, 224.0, 229.0, 187.0, 195.0, 202.0, 182.0, 193.0, 199.0, 181.0, 191.0, 200.0, 180.0, 190.0, 197.0, 180.0, 189.0, 197.0, 184.0, 191.0, 196.0, 189.0, 193.0, 199.0, 179.0, 189.0, 196.0, 176.0, 186.0, 192.0, 175.0, 184.0, 191.0, 172.0, 181.0, 190.0, 171.0, 180.0, 189.0, 170.0, 179.0, 188.0, 167.0, 176.0, 185.0, 165.0, 174.0, 183.0, 161.0, 156.0, 165.0, 161.0, 157.0, 166.0, 159.0, 158.0, 168.0, 159.0, 160.0, 167.0, 165.0, 165.0, 174.0, 163.0, 166.0, 174.0, 166.0, 170.0, 179.0, 169.0, 173.0, 184.0, 171.0, 176.0, 186.0, 172.0, 177.0, 186.0, 175.0, 178.0, 187.0, 174.0, 181.0, 189.0, 172.0, 183.0, 191.0, 176.0, 182.0, 189.0, 157.0, 155.0, 157.0, 181.0, 178.0, 181.0, 222.0, 228.0, 232.0, 199.0, 207.0, 213.0, 179.0, 189.0, 197.0, 181.0, 191.0, 200.0, 178.0, 188.0, 196.0, 176.0, 187.0, 194.0, 183.0, 192.0, 198.0, 189.0, 193.0, 198.0, 179.0, 188.0, 195.0, 174.0, 184.0, 192.0, 173.0, 182.0, 191.0, 171.0, 181.0, 190.0, 170.0, 180.0, 189.0, 169.0, 179.0, 188.0, 167.0, 177.0, 186.0, 165.0, 174.0, 183.0, 158.0, 155.0, 164.0, 156.0, 156.0, 166.0, 155.0, 152.0, 154.0, 159.0, 155.0, 154.0, 162.0, 163.0, 173.0, 154.0, 154.0, 158.0, 164.0, 167.0, 176.0, 166.0, 173.0, 183.0, 168.0, 173.0, 183.0, 170.0, 173.0, 183.0, 171.0, 177.0, 186.0, 170.0, 176.0, 183.0, 173.0, 177.0, 181.0, 189.0, 196.0, 203.0, 197.0, 196.0, 200.0, 197.0, 203.0, 210.0, 201.0, 219.0, 232.0, 195.0, 211.0, 218.0, 169.0, 184.0, 194.0, 203.0, 211.0, 216.0, 198.0, 206.0, 210.0, 179.0, 190.0, 195.0, 180.0, 189.0, 195.0, 195.0, 199.0, 203.0, 180.0, 188.0, 195.0, 174.0, 183.0, 192.0, 172.0, 181.0, 190.0, 169.0, 179.0, 188.0, 168.0, 178.0, 187.0, 167.0, 177.0, 186.0, 166.0, 176.0, 185.0, 164.0, 173.0, 182.0, 155.0, 152.0, 161.0, 155.0, 153.0, 164.0, 159.0, 150.0, 150.0, 177.0, 167.0, 161.0, 159.0, 160.0, 169.0, 164.0, 155.0, 153.0, 167.0, 169.0, 176.0, 167.0, 168.0, 178.0, 168.0, 168.0, 174.0, 166.0, 173.0, 179.0, 172.0, 178.0, 186.0, 178.0, 178.0, 179.0, 189.0, 186.0, 185.0, 218.0, 219.0, 221.0, 239.0, 237.0, 237.0, 231.0, 235.0, 238.0, 211.0, 223.0, 231.0, 207.0, 218.0, 222.0, 167.0, 180.0, 186.0, 186.0, 194.0, 196.0, 199.0, 209.0, 209.0, 204.0, 210.0, 213.0, 201.0, 205.0, 211.0, 207.0, 211.0, 215.0, 185.0, 193.0, 200.0, 169.0, 178.0, 187.0, 170.0, 180.0, 189.0, 168.0, 178.0, 187.0, 167.0, 177.0, 186.0, 166.0, 177.0, 185.0, 165.0, 175.0, 184.0, 163.0, 172.0, 181.0, 154.0, 154.0, 165.0, 155.0, 155.0, 163.0, 167.0, 161.0, 162.0, 191.0, 180.0, 173.0, 160.0, 161.0, 169.0, 186.0, 176.0, 173.0, 184.0, 182.0, 185.0, 192.0, 186.0, 191.0, 197.0, 194.0, 197.0, 187.0, 189.0, 194.0, 189.0, 189.0, 197.0, 206.0, 199.0, 201.0, 209.0, 201.0, 200.0, 213.0, 210.0, 206.0, 227.0, 225.0, 223.0, 232.0, 231.0, 228.0, 230.0, 230.0, 227.0, 238.0, 235.0, 235.0, 218.0, 218.0, 219.0, 199.0, 202.0, 204.0, 203.0, 207.0, 208.0, 227.0, 228.0, 228.0, 220.0, 221.0, 226.0, 222.0, 224.0, 229.0, 209.0, 213.0, 219.0, 178.0, 183.0, 191.0, 167.0, 172.0, 182.0, 168.0, 178.0, 185.0, 166.0, 178.0, 185.0, 163.0, 176.0, 183.0, 161.0, 172.0, 179.0, 160.0, 170.0, 179.0, 151.0, 139.0, 138.0, 150.0, 139.0, 140.0, 167.0, 156.0, 150.0, 197.0, 185.0, 177.0, 185.0, 180.0, 181.0, 194.0, 186.0, 177.0, 200.0, 193.0, 184.0, 197.0, 187.0, 186.0, 186.0, 177.0, 178.0, 157.0, 153.0, 160.0, 135.0, 137.0, 149.0, 161.0, 159.0, 167.0, 209.0, 202.0, 203.0, 210.0, 209.0, 208.0, 227.0, 226.0, 227.0, 219.0, 219.0, 221.0, 215.0, 214.0, 216.0, 215.0, 197.0, 197.0, 215.0, 191.0, 186.0, 214.0, 210.0, 209.0, 202.0, 199.0, 202.0, 213.0, 208.0, 210.0, 225.0, 219.0, 222.0, 222.0, 216.0, 222.0, 233.0, 229.0, 233.0, 214.0, 215.0, 218.0, 193.0, 194.0, 200.0, 186.0, 191.0, 197.0, 168.0, 176.0, 184.0, 160.0, 170.0, 179.0, 159.0, 161.0, 168.0, 161.0, 169.0, 180.0, 152.0, 116.0, 97.0, 146.0, 112.0, 97.0, 163.0, 133.0, 119.0, 210.0, 196.0, 189.0, 209.0, 194.0, 188.0, 201.0, 187.0, 177.0, 186.0, 174.0, 164.0, 147.0, 135.0, 134.0, 133.0, 120.0, 122.0, 131.0, 123.0, 130.0, 132.0, 122.0, 131.0, 173.0, 167.0, 172.0, 218.0, 216.0, 219.0, 207.0, 204.0, 208.0, 203.0, 202.0, 206.0, 204.0, 203.0, 207.0, 214.0, 211.0, 212.0, 202.0, 189.0, 188.0, 198.0, 181.0, 179.0, 204.0, 199.0, 201.0, 204.0, 196.0, 199.0, 201.0, 194.0, 201.0, 206.0, 195.0, 198.0, 205.0, 195.0, 199.0, 203.0, 196.0, 197.0, 201.0, 198.0, 196.0, 217.0, 213.0, 215.0, 209.0, 206.0, 210.0, 177.0, 175.0, 180.0, 162.0, 158.0, 160.0, 158.0, 141.0, 137.0, 156.0, 142.0, 144.0, 197.0, 138.0, 101.0, 198.0, 133.0, 94.0, 189.0, 135.0, 115.0, 176.0, 151.0, 148.0, 155.0, 138.0, 134.0, 189.0, 175.0, 172.0, 179.0, 166.0, 162.0, 144.0, 131.0, 133.0, 137.0, 129.0, 134.0, 161.0, 153.0, 159.0, 178.0, 169.0, 173.0, 228.0, 224.0, 226.0, 217.0, 216.0, 218.0, 212.0, 211.0, 213.0, 214.0, 214.0, 216.0, 212.0, 212.0, 213.0, 216.0, 217.0, 218.0, 186.0, 189.0, 197.0, 169.0, 172.0, 183.0, 174.0, 176.0, 187.0, 167.0, 167.0, 176.0, 165.0, 167.0, 176.0, 172.0, 170.0, 177.0, 161.0, 159.0, 165.0, 193.0, 190.0, 194.0, 232.0, 230.0, 230.0, 240.0, 237.0, 239.0, 236.0, 236.0, 239.0, 201.0, 188.0, 185.0, 171.0, 136.0, 121.0, 167.0, 122.0, 99.0, 171.0, 128.0, 109.0, 207.0, 141.0, 95.0, 182.0, 133.0, 110.0, 167.0, 136.0, 127.0, 155.0, 139.0, 144.0, 148.0, 134.0, 134.0, 181.0, 171.0, 167.0, 166.0, 151.0, 149.0, 150.0, 135.0, 136.0, 147.0, 137.0, 141.0, 147.0, 136.0, 140.0, 171.0, 161.0, 165.0, 236.0, 232.0, 234.0, 212.0, 212.0, 212.0, 213.0, 213.0, 213.0, 221.0, 221.0, 221.0, 220.0, 220.0, 219.0, 222.0, 223.0, 222.0, 213.0, 214.0, 218.0, 191.0, 191.0, 199.0, 196.0, 196.0, 204.0, 189.0, 189.0, 195.0, 194.0, 194.0, 198.0, 196.0, 193.0, 199.0, 190.0, 185.0, 191.0, 218.0, 215.0, 218.0, 235.0, 234.0, 234.0, 228.0, 226.0, 227.0, 223.0, 224.0, 225.0, 222.0, 222.0, 220.0, 202.0, 184.0, 175.0, 173.0, 133.0, 111.0, 172.0, 127.0, 104.0, 203.0, 145.0, 104.0, 153.0, 127.0, 108.0, 119.0, 107.0, 107.0, 130.0, 118.0, 123.0, 143.0, 129.0, 130.0, 157.0, 150.0, 150.0, 156.0, 150.0, 149.0, 173.0, 165.0, 164.0, 181.0, 174.0, 174.0, 224.0, 218.0, 218.0, 221.0, 218.0, 217.0, 207.0, 207.0, 206.0, 221.0, 220.0, 219.0, 219.0, 218.0, 218.0, 220.0, 218.0, 219.0, 217.0, 216.0, 216.0, 218.0, 220.0, 220.0, 233.0, 237.0, 236.0, 211.0, 215.0, 217.0, 202.0, 206.0, 209.0, 205.0, 211.0, 212.0, 206.0, 212.0, 213.0, 205.0, 212.0, 214.0, 216.0, 223.0, 226.0, 224.0, 231.0, 234.0, 208.0, 213.0, 217.0, 204.0, 211.0, 215.0, 204.0, 212.0, 214.0, 212.0, 222.0, 228.0, 214.0, 207.0, 203.0, 193.0, 149.0, 125.0, 192.0, 137.0, 108.0, 181.0, 128.0, 96.0, 127.0, 102.0, 90.0, 90.0, 83.0, 89.0, 92.0, 90.0, 97.0, 91.0, 92.0, 100.0, 103.0, 109.0, 118.0, 109.0, 121.0, 129.0, 149.0, 162.0, 169.0, 155.0, 166.0, 172.0, 209.0, 220.0, 223.0, 201.0, 210.0, 213.0, 191.0, 200.0, 203.0, 205.0, 213.0, 219.0, 205.0, 213.0, 220.0, 208.0, 218.0, 224.0, 208.0, 220.0, 226.0, 213.0, 223.0, 227.0, 222.0, 231.0, 235.0, 216.0, 226.0, 232.0, 215.0, 225.0, 231.0, 217.0, 227.0, 232.0, 219.0, 229.0, 234.0, 221.0, 230.0, 234.0, 227.0, 234.0, 236.0, 230.0, 236.0, 239.0, 228.0, 234.0, 237.0, 229.0, 234.0, 237.0, 232.0, 235.0, 237.0, 232.0, 234.0, 237.0, 216.0, 212.0, 207.0, 218.0, 203.0, 191.0, 224.0, 213.0, 196.0, 160.0, 117.0, 92.0, 84.0, 74.0, 72.0, 51.0, 56.0, 64.0, 45.0, 54.0, 62.0, 52.0, 63.0, 72.0, 61.0, 72.0, 83.0, 74.0, 85.0, 98.0, 101.0, 112.0, 127.0, 153.0, 166.0, 177.0, 214.0, 223.0, 228.0, 222.0, 227.0, 232.0, 225.0, 230.0, 235.0, 228.0, 233.0, 236.0, 229.0, 235.0, 238.0, 232.0, 236.0, 238.0, 233.0, 237.0, 240.0, 236.0, 238.0, 240.0, 238.0, 239.0, 240.0, 241.0, 241.0, 242.0, 242.0, 243.0, 244.0, 243.0, 243.0, 243.0, 244.0, 243.0, 243.0, 244.0, 243.0, 243.0, 245.0, 245.0, 245.0, 245.0, 244.0, 244.0, 241.0, 241.0, 240.0, 241.0, 240.0, 240.0, 242.0, 240.0, 240.0, 230.0, 227.0, 226.0, 210.0, 202.0, 194.0, 220.0, 208.0, 196.0, 218.0, 209.0, 194.0, 152.0, 119.0, 93.0, 118.0, 106.0, 102.0, 102.0, 100.0, 96.0, 102.0, 105.0, 105.0, 125.0, 127.0, 129.0, 139.0, 140.0, 142.0, 156.0, 153.0, 157.0, 198.0, 191.0, 194.0, 223.0, 220.0, 220.0, 229.0, 228.0, 229.0, 241.0, 237.0, 239.0, 241.0, 237.0, 238.0, 245.0, 241.0, 239.0, 243.0, 240.0, 238.0, 243.0, 241.0, 240.0, 243.0, 241.0, 238.0, 243.0, 242.0, 240.0, 242.0, 242.0, 241.0, 243.0, 243.0, 241.0, 243.0, 241.0, 241.0, 243.0, 241.0, 243.0, 244.0, 242.0, 244.0, 244.0, 242.0, 244.0, 244.0, 243.0, 246.0, 246.0, 244.0, 245.0, 245.0, 242.0, 242.0, 245.0, 243.0, 242.0, 235.0, 235.0, 236.0, 177.0, 176.0, 176.0, 150.0, 145.0, 136.0, 150.0, 142.0, 131.0, 138.0, 132.0, 119.0, 103.0, 79.0, 65.0, 121.0, 114.0, 112.0, 123.0, 121.0, 117.0, 128.0, 129.0, 125.0, 146.0, 147.0, 144.0, 163.0, 164.0, 161.0, 195.0, 192.0, 190.0, 234.0, 229.0, 228.0, 238.0, 236.0, 236.0, 235.0, 234.0, 234.0, 235.0, 233.0, 234.0, 236.0, 235.0, 236.0, 241.0, 240.0, 241.0, 239.0, 237.0, 239.0, 241.0, 239.0, 242.0, 245.0, 241.0, 243.0, 239.0, 235.0, 237.0, 245.0, 243.0, 242.0, 246.0, 245.0, 246.0, 249.0, 246.0, 247.0, 247.0, 247.0, 245.0, 248.0, 247.0, 248.0, 245.0, 244.0, 244.0, 242.0, 241.0, 240.0, 240.0, 239.0, 240.0, 234.0, 234.0, 236.0, 220.0, 221.0, 222.0, 188.0, 195.0, 190.0, 139.0, 149.0, 143.0, 115.0, 127.0, 122.0, 103.0, 119.0, 112.0, 97.0, 113.0, 108.0, 70.0, 53.0, 48.0, 111.0, 104.0, 100.0, 123.0, 122.0, 118.0, 129.0, 131.0, 128.0, 142.0, 144.0, 142.0, 157.0, 159.0, 156.0, 192.0, 189.0, 189.0, 224.0, 220.0, 219.0, 228.0, 226.0, 223.0, 231.0, 230.0, 226.0, 235.0, 234.0, 230.0, 239.0, 237.0, 234.0, 242.0, 239.0, 240.0, 245.0, 242.0, 242.0, 247.0, 244.0, 244.0, 219.0, 224.0, 216.0, 193.0, 200.0, 185.0, 188.0, 204.0, 187.0, 185.0, 209.0, 188.0, 190.0, 210.0, 189.0, 219.0, 223.0, 222.0, 220.0, 223.0, 225.0, 209.0, 213.0, 211.0, 200.0, 204.0, 198.0, 192.0, 197.0, 193.0, 188.0, 195.0, 191.0, 176.0, 184.0, 178.0, 164.0, 174.0, 165.0, 155.0, 171.0, 161.0, 134.0, 157.0, 152.0, 117.0, 145.0, 140.0, 110.0, 138.0, 137.0, 56.0, 44.0, 47.0, 66.0, 60.0, 58.0, 114.0, 114.0, 109.0, 128.0, 130.0, 127.0, 137.0, 138.0, 136.0, 152.0, 154.0, 150.0, 178.0, 178.0, 174.0, 194.0, 194.0, 190.0, 192.0, 195.0, 189.0, 192.0, 195.0, 190.0, 194.0, 197.0, 192.0, 196.0, 199.0, 195.0, 197.0, 200.0, 199.0, 203.0, 205.0, 203.0, 193.0, 196.0, 194.0, 141.0, 154.0, 136.0, 104.0, 124.0, 107.0, 99.0, 123.0, 114.0, 113.0, 149.0, 114.0, 123.0, 158.0, 137.0, 174.0, 185.0, 180.0, 180.0, 188.0, 184.0, 175.0, 184.0, 178.0, 172.0, 181.0, 174.0, 162.0, 172.0, 166.0, 160.0, 174.0, 167.0, 149.0, 164.0, 158.0, 138.0, 154.0, 150.0, 129.0, 148.0, 144.0, 116.0, 139.0, 137.0, 106.0, 132.0, 129.0, 101.0, 127.0, 125.0, 26.0, 22.0, 23.0, 27.0, 25.0, 28.0, 71.0, 71.0, 74.0, 89.0, 94.0, 97.0, 95.0, 101.0, 106.0, 112.0, 116.0, 117.0, 119.0, 121.0, 118.0, 111.0, 117.0, 110.0, 113.0, 123.0, 111.0, 120.0, 129.0, 118.0, 122.0, 131.0, 122.0, 134.0, 143.0, 134.0, 149.0, 160.0, 150.0, 160.0, 170.0, 161.0, 166.0, 175.0, 168.0, 155.0, 169.0, 159.0, 141.0, 156.0, 151.0, 141.0, 151.0, 152.0, 152.0, 158.0, 155.0, 154.0, 166.0, 164.0, 163.0, 176.0, 171.0, 155.0, 168.0, 164.0, 144.0, 159.0, 154.0, 133.0, 151.0, 145.0, 131.0, 148.0, 144.0, 135.0, 152.0, 149.0, 128.0, 147.0, 145.0, 120.0, 142.0, 140.0, 116.0, 139.0, 136.0, 109.0, 134.0, 131.0, 103.0, 128.0, 126.0, 101.0, 125.0, 124.0, 75.0, 78.0, 69.0, 77.0, 80.0, 70.0, 75.0, 81.0, 70.0, 74.0, 85.0, 75.0, 81.0, 93.0, 85.0, 91.0, 102.0, 90.0, 105.0, 115.0, 100.0, 124.0, 131.0, 118.0, 141.0, 146.0, 134.0, 152.0, 157.0, 146.0, 162.0, 167.0, 158.0, 165.0, 170.0, 161.0, 164.0, 174.0, 163.0, 169.0, 179.0, 169.0, 174.0, 179.0, 172.0, 172.0, 181.0, 173.0, 169.0, 180.0, 172.0, 154.0, 169.0, 159.0, 145.0, 163.0, 156.0, 142.0, 158.0, 153.0, 138.0, 155.0, 152.0, 132.0, 149.0, 148.0, 131.0, 149.0, 147.0, 125.0, 146.0, 143.0, 123.0, 144.0, 142.0, 123.0, 145.0, 144.0, 122.0, 144.0, 143.0, 121.0, 143.0, 141.0, 116.0, 139.0, 137.0, 111.0, 135.0, 133.0, 105.0, 129.0, 127.0, 100.0, 124.0, 124.0, 91.0, 94.0, 85.0, 88.0, 93.0, 82.0, 87.0, 96.0, 83.0, 89.0, 99.0, 88.0, 94.0, 105.0, 94.0, 100.0, 112.0, 101.0, 114.0, 125.0, 114.0, 135.0, 141.0, 133.0, 152.0, 154.0, 149.0, 159.0, 162.0, 157.0, 163.0, 167.0, 162.0, 165.0, 169.0, 164.0, 163.0, 170.0, 165.0, 162.0, 171.0, 165.0, 159.0, 166.0, 164.0, 158.0, 166.0, 165.0, 156.0, 165.0, 163.0, 143.0, 156.0, 153.0, 134.0, 149.0, 149.0, 135.0, 150.0, 150.0, 126.0, 146.0, 146.0, 123.0, 143.0, 144.0, 125.0, 144.0, 145.0, 127.0, 145.0, 145.0, 126.0, 146.0, 146.0, 121.0, 143.0, 144.0, 116.0, 138.0, 139.0, 113.0, 135.0, 137.0, 127.0, 143.0, 142.0, 167.0, 170.0, 169.0, 157.0, 162.0, 159.0, 105.0, 126.0, 123.0, 89.0, 92.0, 87.0, 85.0, 93.0, 86.0, 87.0, 96.0, 89.0, 87.0, 99.0, 93.0, 90.0, 104.0, 98.0, 96.0, 110.0, 104.0, 104.0, 116.0, 111.0, 117.0, 125.0, 121.0, 129.0, 136.0, 132.0, 140.0, 147.0, 143.0, 144.0, 154.0, 149.0, 142.0, 151.0, 146.0, 150.0, 157.0, 153.0, 144.0, 156.0, 151.0, 148.0, 159.0, 157.0, 144.0, 154.0, 153.0, 144.0, 156.0, 154.0, 136.0, 153.0, 150.0, 129.0, 147.0, 146.0, 131.0, 149.0, 149.0, 124.0, 143.0, 144.0, 118.0, 139.0, 140.0, 118.0, 139.0, 140.0, 120.0, 141.0, 142.0, 118.0, 141.0, 141.0, 106.0, 133.0, 132.0, 101.0, 127.0, 125.0, 116.0, 136.0, 134.0, 157.0, 157.0, 159.0, 159.0, 143.0, 137.0, 145.0, 124.0, 115.0, 122.0, 125.0, 120.0, 86.0, 94.0, 90.0, 84.0, 95.0, 91.0, 86.0, 99.0, 94.0, 86.0, 102.0, 98.0, 87.0, 105.0, 102.0, 91.0, 109.0, 105.0, 97.0, 112.0, 109.0, 105.0, 118.0, 116.0, 112.0, 126.0, 124.0, 120.0, 134.0, 131.0, 125.0, 137.0, 136.0, 132.0, 144.0, 142.0, 136.0, 146.0, 145.0, 128.0, 142.0, 139.0, 137.0, 148.0, 147.0, 140.0, 150.0, 149.0, 139.0, 151.0, 149.0, 131.0, 148.0, 145.0, 127.0, 146.0, 144.0, 127.0, 145.0, 145.0, 116.0, 136.0, 137.0, 119.0, 141.0, 141.0, 115.0, 138.0, 138.0, 111.0, 135.0, 135.0, 108.0, 133.0, 132.0, 102.0, 128.0, 127.0, 100.0, 124.0, 122.0, 122.0, 129.0, 123.0, 161.0, 154.0, 151.0, 163.0, 150.0, 141.0, 166.0, 146.0, 134.0, 163.0, 160.0, 150.0, 83.0, 92.0, 90.0, 82.0, 94.0, 91.0, 84.0, 97.0, 93.0, 85.0, 100.0, 97.0, 87.0, 103.0, 101.0, 87.0, 105.0, 102.0, 90.0, 109.0, 106.0, 100.0, 117.0, 114.0, 107.0, 123.0, 120.0, 110.0, 125.0, 124.0, 114.0, 129.0, 129.0, 119.0, 133.0, 134.0, 118.0, 132.0, 133.0, 126.0, 140.0, 141.0, 133.0, 145.0, 144.0, 133.0, 144.0, 143.0, 129.0, 143.0, 142.0, 120.0, 138.0, 136.0, 116.0, 136.0, 135.0, 117.0, 136.0, 135.0, 110.0, 133.0, 132.0, 109.0, 134.0, 134.0, 107.0, 132.0, 131.0, 109.0, 131.0, 132.0, 120.0, 138.0, 140.0, 116.0, 132.0, 134.0, 99.0, 115.0, 121.0, 116.0, 121.0, 122.0, 181.0, 174.0, 160.0, 200.0, 193.0, 179.0, 190.0, 187.0, 174.0, 160.0, 165.0, 156.0, 82.0, 91.0, 88.0, 81.0, 92.0, 88.0, 82.0, 94.0, 90.0, 84.0, 98.0, 95.0, 87.0, 102.0, 99.0, 88.0, 104.0, 100.0, 88.0, 105.0, 102.0, 95.0, 111.0, 108.0, 102.0, 117.0, 114.0, 105.0, 120.0, 118.0, 109.0, 123.0, 124.0, 109.0, 123.0, 124.0, 110.0, 125.0, 126.0, 121.0, 135.0, 136.0, 120.0, 134.0, 132.0, 125.0, 139.0, 137.0, 127.0, 142.0, 142.0, 118.0, 137.0, 136.0, 114.0, 135.0, 134.0, 117.0, 137.0, 136.0, 117.0, 138.0, 138.0, 116.0, 136.0, 137.0, 115.0, 134.0, 136.0, 125.0, 140.0, 143.0, 132.0, 144.0, 148.0, 130.0, 143.0, 146.0, 111.0, 126.0, 131.0, 106.0, 118.0, 116.0, 147.0, 149.0, 134.0, 149.0, 152.0, 140.0, 127.0, 135.0, 128.0, 111.0, 126.0, 124.0, };
```

## include/output_data.h
```c
#include <stddef.h>
#include <stdint.h>
#include <dlpack/dlpack.h>
const size_t output_data_len = 10;
float output_data[] = {0.0, 0.0, 0.0, 0.0, 0.0, 0.0, 0.0, 0.0, 0.0, 0.0, };
```

## include/zephyr_uart.h
```c
/*
 * Licensed to the Apache Software Foundation (ASF) under one
 * or more contributor license agreements.  See the NOTICE file
 * distributed with this work for additional information
 * regarding copyright ownership.  The ASF licenses this file
 * to you under the Apache License, Version 2.0 (the
 * "License"); you may not use this file except in compliance
 * with the License.  You may obtain a copy of the License at
 *
 *   http://www.apache.org/licenses/LICENSE-2.0
 *
 * Unless required by applicable law or agreed to in writing,
 * software distributed under the License is distributed on an
 * "AS IS" BASIS, WITHOUT WARRANTIES OR CONDITIONS OF ANY
 * KIND, either express or implied.  See the License for the
 * specific language governing permissions and limitations
 * under the License.
 */

#ifndef TVM_APPS_MICROTVM_ZEPHYR_AOT_DEMO_INCLUDE_ZEPHYR_UART_H_
#define TVM_APPS_MICROTVM_ZEPHYR_AOT_DEMO_INCLUDE_ZEPHYR_UART_H_

#include <drivers/uart.h>
#include <sys/ring_buffer.h>

static const struct device* g_utvm_uart;
#define RING_BUF_SIZE_BYTES (TVM_CRT_MAX_PACKET_SIZE_BYTES + 100)

// Ring buffer used to store data read from the UART on rx interrupt.
RING_BUF_DECLARE(uart_rx_rbuf, RING_BUF_SIZE_BYTES);

size_t write_serial(const char* data, size_t size) {
  for (size_t i = 0; i < size; i++) {
    uart_poll_out(g_utvm_uart, data[i]);
  }
  return size;
}

static uint8_t uart_data[8];
// UART interrupt callback.
void uart_irq_cb(const struct device* dev, void* user_data) {
  while (uart_irq_update(dev) && uart_irq_is_pending(dev)) {
    struct ring_buf* rbuf = (struct ring_buf*)user_data;
    if (uart_irq_rx_ready(dev) != 0) {
      for (;;) {
        // Read a small chunk of data from the UART.
        int bytes_read = uart_fifo_read(dev, uart_data, sizeof(uart_data));
        if (bytes_read < 0) {
          TVMPlatformAbort((tvm_crt_error_t)(0xbeef1));
        } else if (bytes_read == 0) {
          break;
        }
        // Write it into the ring buffer.
        int bytes_written = ring_buf_put(rbuf, uart_data, bytes_read);
        if (bytes_read != bytes_written) {
          TVMPlatformAbort((tvm_crt_error_t)(0xbeef2));
        }
      }
    }
  }
}

// Used to initialize the UART receiver.
void uart_rx_init(struct ring_buf* rbuf, const struct device* dev) {
  uart_irq_callback_user_data_set(dev, uart_irq_cb, (void*)rbuf);
  uart_irq_rx_enable(dev);
}

// Used to read data from the UART.
int uart_rx_buf_read(uint8_t* data, size_t data_size_bytes) {
  unsigned int key = irq_lock();
  int bytes_read = ring_buf_get(&uart_rx_rbuf, data, data_size_bytes);
  irq_unlock(key);
  return bytes_read;
}

// Initialize UART
void TVMPlatformUARTInit() {
  // Claim console device.
  g_utvm_uart = device_get_binding(DT_LABEL(DT_CHOSEN(zephyr_console)));
  uart_rx_init(&uart_rx_rbuf, g_utvm_uart);
}

#endif /* TVM_APPS_MICROTVM_ZEPHYR_AOT_DEMO_INCLUDE_ZEPHYR_UART_H_ */
```

## src/zephyr_uart.c
```c
/*
 * Licensed to the Apache Software Foundation (ASF) under one
 * or more contributor license agreements.  See the NOTICE file
 * distributed with this work for additional information
 * regarding copyright ownership.  The ASF licenses this file
 * to you under the Apache License, Version 2.0 (the
 * "License"); you may not use this file except in compliance
 * with the License.  You may obtain a copy of the License at
 *
 *   http://www.apache.org/licenses/LICENSE-2.0
 *
 * Unless required by applicable law or agreed to in writing,
 * software distributed under the License is distributed on an
 * "AS IS" BASIS, WITHOUT WARRANTIES OR CONDITIONS OF ANY
 * KIND, either express or implied.  See the License for the
 * specific language governing permissions and limitations
 * under the License.
 */
#include "zephyr_uart.h"

#include <drivers/uart.h>
#include <sys/ring_buffer.h>

#include "crt_config.h"

static const struct device* g_microtvm_uart;
#define RING_BUF_SIZE_BYTES (TVM_CRT_MAX_PACKET_SIZE_BYTES + 100)

// Ring buffer used to store data read from the UART on rx interrupt.
RING_BUF_DECLARE(uart_rx_rbuf, RING_BUF_SIZE_BYTES);

static uint8_t uart_data[8];
// UART interrupt callback.
void uart_irq_cb(const struct device* dev, void* user_data) {
  while (uart_irq_update(dev) && uart_irq_is_pending(dev)) {
    struct ring_buf* rbuf = (struct ring_buf*)user_data;
    if (uart_irq_rx_ready(dev) != 0) {
      for (;;) {
        // Read a small chunk of data from the UART.
        int bytes_read = uart_fifo_read(dev, uart_data, sizeof(uart_data));
        if (bytes_read < 0) {
          TVMPlatformAbort((tvm_crt_error_t)(0xbeef1));
        } else if (bytes_read == 0) {
          break;
        }
        // Write it into the ring buffer.
        int bytes_written = ring_buf_put(rbuf, uart_data, bytes_read);
        if (bytes_read != bytes_written) {
          TVMPlatformAbort((tvm_crt_error_t)(0xbeef2));
        }
      }
    }
  }
}

// Used to initialize the UART receiver.
void uart_rx_init(struct ring_buf* rbuf, const struct device* dev) {
  uart_irq_callback_user_data_set(dev, uart_irq_cb, (void*)rbuf);
  uart_irq_rx_enable(dev);
}

uint32_t TVMPlatformUartRxRead(uint8_t* data, uint32_t data_size_bytes) {
  unsigned int key = irq_lock();
  uint32_t bytes_read = ring_buf_get(&uart_rx_rbuf, data, data_size_bytes);
  irq_unlock(key);
  return bytes_read;
}

uint32_t TVMPlatformWriteSerial(const char* data, uint32_t size) {
  for (uint32_t i = 0; i < size; i++) {
    uart_poll_out(g_microtvm_uart, data[i]);
  }
  return size;
}

// Initialize UART
void TVMPlatformUARTInit() {
  // Claim console device.
  g_microtvm_uart = device_get_binding(DT_LABEL(DT_CHOSEN(zephyr_console)));
  uart_rx_init(&uart_rx_rbuf, g_microtvm_uart);
}
```
